## CMakeLists.txt
```
cmake_minimum_required(VERSION 3.13.1)

if(NOT DEFINED BOARD)
  set(BOARD nrf9160_pca10090ns)
endif()

# Add custom signing key to the bootloader (mcuboot) config
set(mcuboot_CONF_FILE
  ${CMAKE_CURRENT_SOURCE_DIR}/../../deps/bootloader/mcuboot/boot/zephyr/prj.conf
  ${CMAKE_CURRENT_SOURCE_DIR}/mcuboot.conf
)

#Include nrf boilerplate
get_filename_component(NRF_BASE $ENV{ZEPHYR_BASE}/../nrf ABSOLUTE)
include(${NRF_BASE}/cmake/boilerplate.cmake)

# Include Zephyr boilerplate
include($ENV{ZEPHYR_BASE}/cmake/app/boilerplate.cmake NO_POLICY_SCOPE)

project(telenor_fota)

target_sources(app PRIVATE src/main.c)
target_sources(app PRIVATE src/fota.c)
zephyr_include_directories(src)
```

## Kconfig
```
menu "Application"

config APP_FIRMWARE_VERSION
	string "The application firmware version"
	default "0.0.0"
	help
	  Should match the version of a firmware image uploaded to https://api.nbiot.engineering/.

module = APP
module-dep = LOG
module-str = Log level for application
source "${ZEPHYR_BASE}/subsys/logging/Kconfig.template.log_config"

endmenu

menu "Zephyr Kernel"
source "$ZEPHYR_BASE/Kconfig.zephyr"
endmenu
```

## prj.conf
```kconfig
# General config
CONFIG_ASSERT=y

# LTE link control
CONFIG_LTE_LINK_CONTROL=y
CONFIG_LTE_AUTO_INIT_AND_CONNECT=y
CONFIG_LTE_PDP_CMD=y
CONFIG_LTE_PDP_CONTEXT="0,\"IP\",\"mda.ee\""

# Heap and stacks
CONFIG_HEAP_MEM_POOL_SIZE=16384
CONFIG_MAIN_STACK_SIZE=8192
CONFIG_SYSTEM_WORKQUEUE_STACK_SIZE=2048
CONFIG_HW_STACK_PROTECTION=y

# Disable native network stack to save some memory
CONFIG_NET_IPV4=n
CONFIG_NET_IPV6=n
CONFIG_NET_UDP=n
CONFIG_NET_TCP=n
CONFIG_NET_RX_STACK_SIZE=1024
CONFIG_NET_TX_STACK_SIZE=1024

# Uncomment the lines below to disable optimizations when debugging
# CONFIG_NO_OPTIMIZATIONS=y
# CONFIG_DEBUG=y


## All of the following options are necessary for FOTA:

CONFIG_APP_FIRMWARE_VERSION="1.0.0"

# Logging
CONFIG_LOG=y
CONFIG_LOG_STRDUP_MAX_STRING=64

# General config
CONFIG_REBOOT=y

# Network
CONFIG_NETWORKING=y

# BSD library
CONFIG_BSD_LIBRARY=y

# LTE link control
CONFIG_LTE_LINK_CONTROL=y

# Modem info
CONFIG_MODEM_INFO=y

# Extend CoAP retry timing to 10 seconds for LTE/LTE-M.
CONFIG_COAP_INIT_ACK_TIMEOUT_MS=10000

# The LwM2M RD server we use returns long options, specifically the client registration endpoint (== IMSI).
CONFIG_COAP_EXTENDED_OPTIONS_LEN=y
CONFIG_COAP_EXTENDED_OPTIONS_LEN_VALUE=32

# LwM2M
CONFIG_LWM2M=y
CONFIG_LWM2M_RW_JSON_SUPPORT=n
CONFIG_LWM2M_ENGINE_DEFAULT_LIFETIME=600
CONFIG_LWM2M_FIRMWARE_UPDATE_OBJ_SUPPORT=y
CONFIG_LWM2M_FIRMWARE_UPDATE_PULL_SUPPORT=y

# Firmware image
CONFIG_BOOTLOADER_MCUBOOT=y
CONFIG_IMG_MANAGER=y
CONFIG_MCUBOOT_IMG_MANAGER=y
CONFIG_IMG_ERASE_PROGRESSIVELY=y
CONFIG_FLASH=y
CONFIG_MPU_ALLOW_FLASH_WRITE=y
CONFIG_DFU_TARGET=y

# Firmware info
CONFIG_SPM_SECURE_SERVICES=y

# Add signing key relative to mcuboot folder
CONFIG_BOOT_SIGNATURE_KEY_FILE="../../../samples/fota/cert.pem"

# Immutable bootloader (secure boot)
CONFIG_SECURE_BOOT=y
CONFIG_SB_SIGNING_KEY_FILE="mcuboot-priv.pem"

# List of public keys stored in One Time Programmable memory, which the immutable bootloader uses to validate mcuboot signature.
# The public key for the signing key is automatically added, and must not be added to the public keys list.
CONFIG_SB_PUBLIC_KEY_FILES="mcuboot-pub2.pem,mcuboot-pub3.pem"

## End FOTA options.
```

## mcuboot.conf
```kconfig
# Add signing key relative to mcuboot folder
CONFIG_BOOT_SIGNATURE_KEY_FILE="../../../samples/fota/cert.pem"

# Image version number for mcuboot. Increase by 1 when updating mcuboot over the air.
CONFIG_FW_INFO_FIRMWARE_VERSION=2

# Disable validation on every boot, so it's possible to update the app signature
# key. Which involves updating both mcuboot and the application at the same time.
CONFIG_BOOT_VALIDATE_SLOT0=n
```

## src/main.c
```c
#include <zephyr.h>
#include <fw_info.h>
#include <logging/log.h>
#include <pm_config.h>
#include <secure_services.h>
#include <fw_info.h>

#include "fota.h"

LOG_MODULE_REGISTER(app_main, CONFIG_APP_LOG_LEVEL);

void main() {
	LOG_INF("fota v2");
	// static const mcuboot_slots_t *mcuboot_slots = (mcuboot_slots_t *)&(NRF_UICR_S->OTP[0]);
	LOG_INF("addr s0 %08X, s1 %08X", PM_S0_ADDRESS, PM_S1_ADDRESS);
	struct fw_info s0_info;
	struct fw_info s1_info;
	uint8_t mcuboot_version = 0;
	uint8_t slot = 0;
	
	int ret = spm_firmware_info(PM_S0_ADDRESS, &s0_info);
	if (ret != 0) {
		LOG_ERR("Could not find firmware info for s0 (err: %d)\n", ret);
	} else {
		if (s0_info.valid == CONFIG_FW_INFO_VALID_VAL) {
			mcuboot_version = (uint8_t) s0_info.version;
		}
		LOG_INF("mcuboot s0 version: %d valid: %d", s0_info.version, s0_info.valid == CONFIG_FW_INFO_VALID_VAL);
	}

	ret = spm_firmware_info(PM_S1_ADDRESS, &s1_info);
	if (ret != 0) {
		LOG_ERR("Could not find firmware info for s1 (err: %d)\n", ret);
	} else {
		if (s1_info.valid == CONFIG_FW_INFO_VALID_VAL && s1_info.version > mcuboot_version) {
			mcuboot_version = (uint8_t) s1_info.version;
			slot = 1;
		}
		LOG_INF("mcuboot s1 version: %d valid: %d", s1_info.version, s1_info.valid == CONFIG_FW_INFO_VALID_VAL);
	}
	
	//LOG_INF("mcuboot s1 version: %d valid: %d", s1_info.version, s1_info.valid == CONFIG_FW_INFO_VALID_VAL);
	//char version[32];
	//snprintk(version, sizeof(version), "boot%d-s%d/app%s", mcuboot_version, slot, CONFIG_APP_FIRMWARE_VERSION);
	fota_client_info client_info = {
		manufacturer: "Exploratory Engineering",
		model_number: "EE-FOTA-00",
		serial_number: "1",
		firmware_version: CONFIG_APP_FIRMWARE_VERSION,
	};

	// Initialize the application and run any self-tests before calling fota_init.
	// Otherwise, if initialization or self-tests fail after an update, reboot the system and the previous firmware image will be used.

	ret = fota_init(client_info);
	if (ret) {
		LOG_ERR("fota_init: %d", ret);
		return;
	}
}
```

## src/fota.c
```c
#include <zephyr.h>
#include <bsd.h>
#include <logging/log.h>
#include <dfu/mcuboot.h>
#include <dfu/dfu_target.h>
#include <power/reboot.h>
#include <modem_info.h>
#include <net/bsdlib.h>
#include <net/lwm2m.h>
#include <stdio.h>

#include "fota.h"

LOG_MODULE_REGISTER(app_fota, CONFIG_APP_LOG_LEVEL);

#include "pm_config.h"
#define FLASH_AREA_IMAGE_SECONDARY PM_MCUBOOT_SECONDARY_ID
#define FLASH_BANK_SIZE            PM_MCUBOOT_SECONDARY_SIZE

static int check_modem_firmware_update() {
	// Modem firmware updates require a second reboot.
	int err = bsdlib_get_init_ret();
	switch (err) {
	case MODEM_DFU_RESULT_OK:
		LOG_INF("Modem firmware update successful!");
		LOG_INF("Modem will run the new firmware after reboot");
		sys_reboot(0);
		break;
	case MODEM_DFU_RESULT_UUID_ERROR:
	case MODEM_DFU_RESULT_AUTH_ERROR:
		LOG_ERR("Modem firmware update failed");
		LOG_ERR("Modem will run non-updated firmware after reboot.");
		sys_reboot(0);
		break;
	case MODEM_DFU_RESULT_HARDWARE_ERROR:
	case MODEM_DFU_RESULT_INTERNAL_ERROR:
		LOG_ERR("Modem firmware update failed: %d", err);
		return err;
	}
	return 0;
}

static struct k_delayed_work reboot_work;

static void do_reboot(struct k_work *work) {
	int ret = boot_request_upgrade(BOOT_UPGRADE_TEST);
	if (ret) {
		LOG_ERR("boot_request_upgrade: %d", ret);
	}

	// removed automatic reboot to inspect flash content
	// sys_reboot(0);
}

static int firmware_update_cb(u16_t obj_inst_id) {
	LOG_INF("Executing firmware update");

	// Wait a few seconds before rebooting so that the lwm2m client has a chance
	// to acknowledge having received the Update signal.
	k_delayed_work_submit(&reboot_work, K_SECONDS(10));

	return 0;
}

static void *firmware_get_buf(u16_t obj_inst_id, u16_t res_id, u16_t res_inst_id, size_t *data_len) {
	static u8_t firmware_buf[CONFIG_LWM2M_COAP_BLOCK_SIZE];
	*data_len = sizeof(firmware_buf);
	return firmware_buf;
}

static void dfu_target_callback_handler(enum dfu_target_evt_id evt) {
	switch (evt) {
	case DFU_TARGET_EVT_TIMEOUT:
		LOG_INF("dfu_target erase pending");
		break;
	case DFU_TARGET_EVT_ERASE_DONE:
		LOG_INF("dfu_target erase done");
		break;
	default:
		LOG_ERR("dfu_target download error");
	}
}

static int firmware_block_received_cb(u16_t obj_inst_id, u16_t res_id, u16_t res_inst_id,
		u8_t *data, u16_t data_len, bool last_block, size_t total_size) {
	if (total_size > FLASH_BANK_SIZE) {
		LOG_ERR("Artifact file size too big: %d", total_size);
		return -EINVAL;
	}

	if (!data_len) {
		LOG_ERR("Data len is zero, nothing to write.");
		return -EINVAL;
	}

	static u32_t bytes_downloaded;
	static u8_t percent_downloaded;

	int ret;

	if (bytes_downloaded == 0) {
		int img_type = dfu_target_img_type(data, data_len);
		if (img_type < 0) {
			LOG_ERR("dfu_target_img_type: %d", img_type);
			return img_type;
		}

		const char *img_type_str = "";
		switch (img_type) {
		case DFU_TARGET_IMAGE_TYPE_MCUBOOT:
			img_type_str = " MCUBoot";
			break;
		case DFU_TARGET_IMAGE_TYPE_MODEM_DELTA:
			img_type_str = " modem delta";
			break;
		}
		LOG_INF("Started downloading%s image", img_type_str);

		ret = dfu_target_init(img_type, total_size, dfu_target_callback_handler);
		if (ret) {
			LOG_ERR("dfu_target_init(%d, %d): %d", img_type, total_size, ret);
			return ret;
		}

#ifndef CONFIG_IMG_ERASE_PROGRESSIVELY
		ret = boot_erase_img_bank(FLASH_AREA_IMAGE_SECONDARY);
		if (ret) {
			LOG_ERR("boot_erase_img_bank: %d", ret);
			goto cleanup;
		}
#endif
	}

	bytes_downloaded += data_len;

	u8_t percent = 100;
	if (total_size) {
		percent = 100 * bytes_downloaded / total_size;
	}
	if (percent_downloaded < percent) {
		percent_downloaded = percent;
		LOG_INF("%d%%", percent_downloaded);
	}

	ret = dfu_target_write(data, data_len);
	if (ret) {
		LOG_ERR("dfu_target_write: %d", ret);
		goto cleanup;
	}

	if (last_block && total_size && bytes_downloaded != total_size) {
		LOG_ERR("Early last block, downloaded %d, expecting %d", bytes_downloaded, total_size);
		ret = -EIO;
		goto cleanup;
	}

	if (last_block) {
		ret = dfu_target_done(true);
		if (ret) {
			LOG_ERR("dfu_target_done(true): %d", ret);
			goto cleanup;
		}
	}

	return 0;

cleanup:
	bytes_downloaded = 0;
	percent_downloaded = 0;

	int done_ret = dfu_target_done(false);
	if (done_ret) {
		LOG_ERR("dfu_target_done(false): %d", done_ret);
	}

	return ret;
}

static int init_lwm2m_resources(fota_client_info client_info) {
	LOG_INF("Firmware version: %s", log_strdup(client_info.firmware_version));
	LOG_INF("Model number:     %s", client_info.model_number);
	LOG_INF("Serial numbera:   %s", client_info.serial_number);
	LOG_INF("Manufacturer:     %s", client_info.manufacturer);

	char *server_url;
	u16_t server_url_len;
	u8_t server_url_flags;
	int ret = lwm2m_engine_get_res_data("0/0/0", (void **)&server_url, &server_url_len, &server_url_flags);
	if (ret) {
		LOG_ERR("Error getting LwM2M server URL data: %d", ret);
		return ret;
	}
	snprintk(server_url, server_url_len, "coap://172.16.15.14");

	// Security Mode (3 == NoSec)
	ret = lwm2m_engine_set_u8("0/0/2", 3);
	if (ret) {
		LOG_ERR("Error setting LwM2M security mode: %d", ret);
		return ret;
	}

	// Firmware pull uses the buffer set by the Package resource (5/0/0) pre-write callback
	// for passing downloaded firmware chunks to the firmware write callback.
	lwm2m_engine_register_pre_write_callback("5/0/0", firmware_get_buf);
	lwm2m_firmware_set_write_cb(firmware_block_received_cb);

	k_delayed_work_init(&reboot_work, do_reboot);
	lwm2m_firmware_set_update_cb(firmware_update_cb);

	lwm2m_engine_set_res_data("3/0/0", client_info.manufacturer, strlen(client_info.manufacturer), LWM2M_RES_DATA_FLAG_RO);
	lwm2m_engine_set_res_data("3/0/1", client_info.model_number, strlen(client_info.model_number), LWM2M_RES_DATA_FLAG_RO);
	lwm2m_engine_set_res_data("3/0/2", client_info.serial_number, strlen(client_info.serial_number), LWM2M_RES_DATA_FLAG_RO);
	lwm2m_engine_set_res_data("3/0/3", client_info.firmware_version, strlen(client_info.firmware_version), LWM2M_RES_DATA_FLAG_RO);

	return 0;
}

static int init_image() {
	if (!boot_is_img_confirmed()) {
		int ret = boot_write_img_confirmed();
		if (ret) {
			LOG_ERR("confirm image: %d", ret);
			return ret;
		}

		LOG_INF("Confirmed firmware image.");
	}

	return 0;
}

static char endpoint_name[20];

static int init_endpoint_name() {
	int err = modem_info_init();
	if (err) {
		LOG_ERR("modem_info_init: %d", err);
		return err;
	}

	char imei[15] = {0};
	int len = modem_info_string_get(MODEM_INFO_IMEI, imei);
	if (len <= 0) {
		LOG_ERR("read IMEI: %d", len);
		return len;
	}
	snprintf(endpoint_name, sizeof(endpoint_name), "nrf-%s", imei);

	char fw_version[MODEM_INFO_MAX_RESPONSE_SIZE] = {0};
	len = modem_info_string_get(MODEM_INFO_FW_VERSION, fw_version);
	if (len <= 0) {
		LOG_ERR("read firmware version: %d", len);
		return len;
	}
	LOG_INF("Modem firmware version: %s", log_strdup(fw_version));

	return 0;
}

int fota_init(fota_client_info client_info) {
	int ret = check_modem_firmware_update();
	if (ret) {
		LOG_ERR("check_modem_firmware_update: %d", ret);
		return ret;
	}
	
	ret = init_lwm2m_resources(client_info);
	if (ret) {
		LOG_ERR("init_lwm2m_resources: %d", ret);
		return ret;
	}

	ret = init_image();
	if (ret) {
		LOG_ERR("init_image: %d", ret);
		return ret;
	}

	ret = init_endpoint_name();
	if (ret) {
		return ret;
	}

	static struct lwm2m_ctx client;
	lwm2m_rd_client_start(&client, endpoint_name, NULL);

	return 0;
}
```

## src/fota.h
```c
#pragma once

// fota_client_info holds info that is reported by the LwM2M client.
// Most fields can have arbitrary data but the firmware_version field
// should match the version of a firmware image uploaded to https://api.nbiot.engineering/.
typedef struct {
	char *manufacturer;
	char *model_number;
	char *serial_number;
	char *firmware_version;
} fota_client_info;

// fota_init assumes that the LTE Link Control subsystem is initialized and a connection established.
// It initializes the Firmware-over-the-Air subsystem, starting the LwM2M client which downloads and installs firmware
// updates, rebooting the device as necessary.
// Call this function after you've initialized your application and done any self-tests to confirm that the system is
// functional after an update; otherwise, reboot the device and it will revert to the the previous confirmed image.
int fota_init(fota_client_info client_info);
```

## src/settings.c
```c
#include <zephyr.h>
#include <logging/log.h>
#include <settings/settings.h>

#include "settings.h"

LOG_MODULE_REGISTER(app_settings, CONFIG_APP_LOG_LEVEL);

static bool updating;

static int set(const char *key, size_t len_rd, settings_read_cb read_cb, void *cb_arg) {
	if (!key) {
		return -ENOENT;
	}

	if (strcmp(key, "updating") == 0) {
		int len = read_cb(cb_arg, &updating, sizeof(updating));
		if (len < sizeof(updating)) {
			LOG_ERR("read updating state");
			updating = false;
		}

		return 0;
	}

	return -ENOENT;
}

static struct settings_handler fota_settings = {
	.name = "fota",
	.h_set = set,
};

int fota_settings_init() {
	int err = settings_subsys_init();
	if (err) {
		LOG_ERR("settings_subsys_init: %d", err);
		return err;
	}

	err = settings_register(&fota_settings);
	if (err) {
		LOG_ERR("settings_register: %d", err);
		return err;
	}

	err = settings_load();
	if (err) {
		LOG_ERR("settings_load: %d", err);
		return err;
	}

	return 0;
}

bool fota_updating() {
	return updating;
}

int fota_set_updating(bool updating_) {
	updating = updating_;
	return settings_save_one("fota/updating", &updating, sizeof(updating));
}
```

## src/settings.h
```c
#pragma once

int fota_settings_init();
bool fota_updating();
int fota_set_updating(bool updating);
```
