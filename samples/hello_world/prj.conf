## CMakeLists.txt
```
#
# Copyright (c) 2019 Exploratory Engineering
#

cmake_minimum_required(VERSION 3.13.1)

if(NOT DEFINED BOARD)
  set(BOARD nrf9160_pca10090ns)
endif()

#Include nrf boilerplate
get_filename_component(NRF_BASE $ENV{ZEPHYR_BASE}/../nrf ABSOLUTE)
include(${NRF_BASE}/cmake/boilerplate.cmake)

# Include Zephyr boilerplate
include($ENV{ZEPHYR_BASE}/cmake/app/boilerplate.cmake NO_POLICY_SCOPE)

project(telenor_hello_world)

zephyr_compile_definitions(PROJECT_NAME=${PROJECT_NAME})
target_sources(app PRIVATE src/main.c)
zephyr_include_directories(src)
```

## prj.conf
```kconfig
CONFIG_BSD_LIBRARY=y
CONFIG_GPIO=n
CONFIG_SERIAL=y
CONFIG_STDOUT_CONSOLE=y
CONFIG_UART_INTERRUPT_DRIVEN=y
CONFIG_NETWORKING=y
CONFIG_NET_BUF_USER_DATA_SIZE=1
CONFIG_NET_SOCKETS_OFFLOAD=y
CONFIG_NET_SOCKETS=y
CONFIG_NET_SOCKETS_POSIX_NAMES=y
CONFIG_TRUSTED_EXECUTION_NONSECURE=y
CONFIG_LOG=n
CONFIG_MAIN_STACK_SIZE=8192
CONFIG_HEAP_MEM_POOL_SIZE=2048

CONFIG_LTE_LINK_CONTROL=y
CONFIG_LTE_NETWORK_MODE_LTE_M=y
CONFIG_LTE_AUTO_INIT_AND_CONNECT=n
CONFIG_LTE_PDP_CMD=y
CONFIG_LTE_PDP_CONTEXT="0,\"IP\",\"mda.ee\""
CONFIG_MODEM_INFO=y

# Uncomment the lines below to disable optimizations when debugging
#CONFIG_NO_OPTIMIZATIONS=y
#CONFIG_DEBUG=y
```

## src/main.c
```c
/*
 * Copyright (c) 2019 Exploratory Engineering
 */
#include <zephyr.h>
#include <errno.h>
#include <stdio.h>
#include <net/socket.h>
#include <lte_lc.h>
#include <modem_info.h>

bool print_imei_imsi() {
	if (modem_info_init() != 0) {
		printf("Modem info could not be initialized");
		return false;
	}

	int ret = lte_lc_normal();
	if (ret != 0) {
		printf("lte_lc_normal: %d\n", ret);
		return false;
	}

	while (true) {
		u16_t uicc_state;
		int len = modem_info_short_get(MODEM_INFO_UICC, &uicc_state);
		if (len <= 0) {
			printf("Failed reading UICC: %d\n", len);
			return false;
		}
		if (uicc_state == 1) {
			break;
		}
		k_sleep(K_SECONDS(1));
	}

	u8_t buf[32] = {0};
	int len = modem_info_string_get(MODEM_INFO_IMEI, buf);
	if (len <= 0) {
		printf("Failed reading IMEI: %d\n", len);
		return false;
	}
	printf("IMEI: %s\n", buf);

	len = modem_info_string_get(MODEM_INFO_IMSI, buf);
	if (len <= 0) {
		printf("Failed reading IMSI: %d\n", len);
		return false;
	}
	printf("IMSI: %s\n", buf);

	ret = lte_lc_offline();
	if (ret != 0) {
		printf("lte_lc_offline: %d\n", ret);
		return false;
	}

	return true;
}

bool send_message(const char *message) {
	int sock = socket(AF_INET, SOCK_DGRAM, IPPROTO_UDP);
	if (sock < 0) {
		printf("Error opening socket: %d\n", errno);
		return false;
	}

	static struct sockaddr_in remote_addr = {
		sin_family: AF_INET,
		sin_port:   htons(1234),
	};
	net_addr_pton(AF_INET, "172.16.15.14", &remote_addr.sin_addr);

	if (sendto(sock, message, strlen(message), 0, (struct sockaddr *)&remote_addr, sizeof(remote_addr)) < 0) {
		printf("Error sending: %d\n", errno);
		close(sock);
		return false;
	}

	close(sock);
	return true;
}

void main() {
	printf("Example application started\n"); 

	int err = lte_lc_init();
	if (err != 0) {
		printf("lte_lc_init failed: %d\n", err);
		return;
	}

	print_imei_imsi();

	printf("Connecting...\n"); 
	err = lte_lc_connect();
	if (err != 0) {
		printf("lte_lc_connect failed: %d\n", err);
		return;
	}

	if (send_message("Hello, World!")) {
		printf("Message sent!\n"); 
	} else {
		printf("Failed to send\n");
	}

	printf("Example application complete\n"); 
}
```
