## lib/fota/Kconfig
```kconfig
menu "Telenor FOTA"

module = TELENOR_FOTA
module-dep = LOG
module-str = Log level for Telenor FOTA
source "${ZEPHYR_BASE}/subsys/logging/Kconfig.template.log_config"

config TELENOR_FOTA
	bool "Use the Telenor FOTA library"
	default n
	help
	  Use the Telenor firmware over the air (FOTA) library.

endmenu
```

## manifest/west.yml
```yaml
west:
  url: https://github.com/zephyrproject-rtos/west
  revision: v0.6.0

manifest:
  defaults:
    remote: ncs

  remotes:
      # nRF Connect SDK base URL.
    - name: ncs
      url-base: https://github.com/NordicPlayground
    - name: zephyrproject
      url-base: https://github.com/zephyrproject-rtos
    - name: throwtheswitch
      url-base: https://github.com/ThrowTheSwitch
    - name: armmbed
      url-base: https://github.com/ARMmbed
    - name: civetweb
      url-base: https://github.com/civetweb

  # The list of external projects for the nRF Connect SDK.
  #
  projects:
    - name: fw-nrfconnect-nrf
      path: deps/nrf
      revision: v1.2.0
    - name: fw-nrfconnect-zephyr
      path: deps/zephyr
      west-commands: scripts/west-commands.yml
      revision: v2.1.99-ncs1
    - name: segger
      revision: 6fcf61606d6012d2c44129edc033f59331e268bc
      path: deps/modules/debug/segger
      remote: zephyrproject
    - name: mbedtls
      path: deps/modules/crypto/mbedtls
      revision: 3776c158fe138a72c97c187e4d31c81c37884be9
      remote: zephyrproject
    - name: mcuboot
      path: deps/bootloader/mcuboot
      repo-path: fw-nrfconnect-mcuboot
      revision: v1.4.99-ncs2
    - name: mcumgr
      repo-path: fw-nrfconnect-mcumgr
      revision: v0.0.1-ncs1
      path: deps/modules/lib/mcumgr
    - name: tinycbor
      repo-path: fw-nrfconnect-tinycbor
      path: deps/modules/lib/tinycbor
      revision: 0fc68fceacd1efc1ce809c5880c380f3d98b7b6e
    - name: ci-tools
      path: deps/tools/ci-tools
      remote: zephyrproject
      revision: e869d2524d1344d80063bf2898095faf9228f7b5
    - name: net-tools
      path: deps/tools/net-tools
      remote: zephyrproject
      revision: 30b7efa827b04d2e47840716b0372737fe7d6c92
    - name: nrfxlib
      path: deps/nrfxlib
      revision: v1.2.0
    - name: cmock
      path: deps/test/cmock
      revision: c243b9a7a7b3c471023193992b46cf1bd1910450
      remote: throwtheswitch
    - name: unity
      path: deps/test/cmock/vendor/unity
      revision: 031f3bbe45f8adf504ca3d13e6f093869920b091
      remote: throwtheswitch
    - name: mbedtls-nrf
      path: deps/mbedtls
      repo-path: mbedtls
      revision: mbedtls-2.16.4
      remote: armmbed
    - name: hal_nordic
      path: deps/modules/hal/nordic
      remote: zephyrproject
      revision: 12d7647870888e4cb0e421f2b26884c2e76915ac
    - name: nrf_hw_models
      path: deps/modules/bsim_hw_models/nrf_hw_models
      remote: zephyrproject
      revision: fec69703cb1ca06fcdab6d5fde01274f0fc5c759
```
